#include <EEPROM.h>

unsigned char MENU_ICON_1[] = {
0xff,0xff,
0xc0,0x01,
0x80,0x00,
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0xf3,0xff
}; 

unsigned char MENU_ICON_2[] = {
0xc7,0xe3,
0xd7,0xeb,
0x90,0x09,
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0x80,0x01
}; 

unsigned char MENU_ICON_3[] = {
0xff,0xff,
0xff,0xff,
0xff,0xff,
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0xff,0xff
}; 

unsigned char MENU_ICON_4[] = {
0xff,0xff,
0x00,0x00,
0x00,0x00,
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0x00,0x00
}; 

unsigned char MENU_ICON_5[] = {
0xff,0xcf,
0xff,0xcf,
0xff,0x0f,
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0xff,0xff
}; 

unsigned char MENU_ICON_6[] = {
0xf3,0xcf,
0xf1,0x8f,
0xf0,0x0f,
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0xf3,0xdf
}; 

unsigned char MENU_ICON_7[] = {
0xff,0xff,
0xfc,0x3f,
0xf8,0x1f,
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0xd0,0x0b
};

// WB skel logo, 357 bytes, 56x51
unsigned char LOGO_IMG[] = {
0x00,0x00,0x05,0x28,0x00,0x00,0x00,
0x00,0x01,0xb5,0x3a,0xe0,0x00,0x00,
0x00,0x01,0x15,0x16,0x80,0x00,0x00,
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0x00,0x00,0x1f,0xfe,0x00,0x00,0x00
}; 

// defines for EEPROM
#define EEPROM_ICON1              32    // +32
#define EEPROM_ICON2              64    // +32
#define EEPROM_ICON3              96    // +32
#define EEPROM_ICON4              128   // + 32
#define EEPROM_ICON5              160   // + 32
#define EEPROM_ICON6              192   // + 32
#define EEPROM_ICON7              224   // + 32
#define EEPROM_LOGO_IMG           256   // + 357
#define EEPROM_USER_NAME          613   // +14
#define EEPROM_CREDITS            627   // + 165
#define EEPROM_PERMISSION_DENIED  792  // +19
#define EEPROM_AP_NAME            811  // +20
#define EEPROM_AP_PASS            831  // +20
#define EEPROM_DEFAULT_AP_NAME    851  // +20
#define EEPROM_DEFAULT_AP_PASS    871  // +20
#define EEPROM_SETTING            891  // +24
#define EEPROM_TABLE_REQUEST      915  // +54
#define EEPROM_VOTE_REQUEST       969  // +54

void WriteToEEPROM(int offset, char *data)
{
  for(int i=0 ; i<=strlen(data); i++)
    EEPROM.write(offset + i, data[i]); 
}

// initial setup
void setup() {      
  int IconList[] = {EEPROM_ICON1, EEPROM_ICON2, EEPROM_ICON3, EEPROM_ICON4, EEPROM_ICON5, EEPROM_ICON6, EEPROM_ICON7};
  unsigned char *iconDataList[] = {MENU_ICON_1, MENU_ICON_2, MENU_ICON_3, MENU_ICON_4, MENU_ICON_5, MENU_ICON_6, MENU_ICON_7};

  // formatting eeprom 
  for(int i=0 ; i<1024; i++)
    EEPROM.write(0 + i, 0x00); 

  // LOGO IMG
  for(int i=0 ; i<sizeof(LOGO_IMG); i++)
    EEPROM.write(EEPROM_LOGO_IMG + i, LOGO_IMG[i] ^ 0xff); 

  // MENU IMG
  for(int idx=0; idx<7; idx++){
    for(int i=0; i<sizeof(MENU_ICON_1); i++)
     EEPROM.write(IconList[idx] + i, iconDataList[idx][i]);            
  }

  // STRINGS
  WriteToEEPROM(EEPROM_SETTING, "Change Name|AP Setting|");
  WriteToEEPROM(EEPROM_PERMISSION_DENIED, "Permission Denied!");
  WriteToEEPROM(EEPROM_AP_NAME, "hghgwifi");
  WriteToEEPROM(EEPROM_AP_PASS, "!SeCrEtPaSsWd!");
  WriteToEEPROM(EEPROM_DEFAULT_AP_NAME, "hghgwifi");
  WriteToEEPROM(EEPROM_DEFAULT_AP_PASS, "!SeCrEtPaSsWd!");  
  WriteToEEPROM(EEPROM_CREDITS, "      [Design]|mattoh,wonlee,mongii|     [Hardware]|      won lee|     [Software]|       mongii|    [PCB outline]|       2doll|    [Assistants]| hdarwin,jakc2,vrat|");  
  WriteToEEPROM(EEPROM_TABLE_REQUEST, "GET /2016/table.php?t=%s&p=%d HTTP/1.0\r\nHost: %s\r\n\r\n");  
  WriteToEEPROM(EEPROM_VOTE_REQUEST, "GET /2016/vote.php?id=%s&sel=%d HTTP/1.0\r\nHost: %s\r\n\r\n");  

  // Finishing Alarm on buzzer
  pinMode(6, OUTPUT);
  for(int i=0; i<10; i++) {
    digitalWrite(6, HIGH);
    delay(10);
    digitalWrite(6, LOW);
    delay(10);
  }
}

// main loop
void loop() {  
}

